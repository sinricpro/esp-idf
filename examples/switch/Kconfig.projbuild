## examples/switch/Kconfig.projbuild
```kconfig
menu "SinricPro Configuration"
    config SINRICPRO_DEBUG
        bool "Enable SinricPro Debug Output"
        default n
        help
            Enable SinricPro debug output.
            
    config SINRICPRO_DEBUG_FUNCTION_TRACKING
        bool "Enable SinricPro Function Tracking"
        depends on SINRICPRO_DEBUG
        default n
        help
            Enable SinricPro function tracking (logs function entry/exit).
            
    config WIFI_SSID
        string "WiFi SSID"
        default "myssid"
        help
            SSID (network name) for the example to connect to.

    config WIFI_PASSWORD
        string "WiFi Password"
        default "mypassword"
        help
            WiFi password (WPA or WPA2) for the example to use.
            
    config SINRICPRO_APP_KEY
        string "SinricPro App Key"
        default ""
        help
            SinricPro App Key from the SinricPro portal.
            
    config SINRICPRO_APP_SECRET
        string "SinricPro App Secret"
        default ""
        help
            SinricPro App Secret from the SinricPro portal.
            
    config SINRICPRO_SWITCH_ID
        string "SinricPro Switch Device ID"
        default ""
        help
            SinricPro Device ID for the switch device.
endmenu
```
