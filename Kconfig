## Kconfig
```kconfig
menu "SinricPro Configuration"

    config SINRICPRO_SERVER_URL
        string "SinricPro Server URL"
        default "ws.sinric.pro"
        help
            WebSocket server URL for SinricPro service.
            Default is "ws.sinric.pro" (port 443 for wss).

    config SINRICPRO_SERVER_PORT
        int "SinricPro Server Port"
        default 443
        help
            WebSocket server port for SinricPro service.
            Use 443 for wss (secure WebSocket).

    config SINRICPRO_WEBSOCKET_PATH
        string "WebSocket Path"
        default "/"
        help
            WebSocket path on the server.

    config SINRICPRO_WEBSOCKET_TASK_STACK_SIZE
        int "WebSocket task stack size"
        default 8192
        help
            Stack size for the WebSocket handling task.
            Increase if you see stack overflow errors.

    config SINRICPRO_WEBSOCKET_TASK_PRIORITY
        int "WebSocket task priority"
        default 5
        range 1 24
        help
            Priority of the WebSocket task.
            Higher values = higher priority.

    config SINRICPRO_CALLBACK_TASK_STACK_SIZE
        int "Callback task stack size"
        default 4096
        help
            Stack size for device callback execution task.

    config SINRICPRO_CALLBACK_TASK_PRIORITY
        int "Callback task priority"
        default 4
        range 1 24
        help
            Priority of the callback execution task.

    config SINRICPRO_ENABLE_DEBUG
        bool "Enable debug logging"
        default n
        help
            Enable verbose debug logging for troubleshooting.

    config SINRICPRO_EVENT_QUEUE_SIZE
        int "Event queue size"
        default 10
        range 5 50
        help
            Maximum number of events that can be queued.

    config SINRICPRO_MESSAGE_QUEUE_SIZE
        int "Message queue size"
        default 10
        range 5 50
        help
            Maximum number of messages that can be queued
            for sending.

    config SINRICPRO_AUTO_RECONNECT
        bool "Enable auto-reconnection"
        default y
        help
            Automatically reconnect when connection is lost.

    config SINRICPRO_RECONNECT_INTERVAL_MS
        int "Reconnection interval (ms)"
        default 5000
        range 1000 60000
        depends on SINRICPRO_AUTO_RECONNECT
        help
            Time to wait before attempting reconnection
            after disconnection.

    config SINRICPRO_MAX_DEVICES
        int "Maximum number of devices"
        default 10
        range 1 50
        help
            Maximum number of devices that can be registered.

    config SINRICPRO_MAX_DEVICE_ID_LEN
        int "Maximum device ID length"
        default 32
        help
            Maximum length of device ID string (including null terminator).

    config SINRICPRO_HEARTBEAT_INTERVAL_MS
        int "Heartbeat interval (ms)"
        default 300000
        range 60000 600000
        help
            Interval for sending heartbeat/ping messages to server.

    config SINRICPRO_ENABLE_LOCAL_CONTROL
        bool "Enable local control (LAN/UDP)"
        default y
        help
            Answer signed SinricPro commands received over the LAN, so the
            device keeps responding to the app while the cloud is unreachable.

            Listens on UDP SINRICPRO_UDP_PORT, joined to the SinricPro
            multicast group and also answering unicast. Requests are dispatched
            through the same capability callbacks as cloud requests.

    config SINRICPRO_LOCAL_CONTROL_NO_MDNS
        bool "Disable the mDNS announcement"
        default n
        depends on SINRICPRO_ENABLE_LOCAL_CONTROL
        help
            Keep the UDP listener but do not publish _sinricpro._udp.local.
            The device is then only reachable at the address the cloud reports
            for it, and cannot be discovered on the LAN.

            Saves the flash and RAM cost of the mdns component.

    config SINRICPRO_UDP_PORT
        int "Local control UDP port"
        default 3333
        range 1 65535
        depends on SINRICPRO_ENABLE_LOCAL_CONTROL
        help
            Wire contract with the SinricPro app. Only change this if the app
            has been configured to match.

    config SINRICPRO_UDP_MULTICAST_IP
        string "Local control multicast group"
        default "224.9.9.9"
        depends on SINRICPRO_ENABLE_LOCAL_CONTROL
        help
            Wire contract with the SinricPro app. Only change this if the app
            has been configured to match.

    config SINRICPRO_UDP_TASK_STACK_SIZE
        int "Local control task stack size"
        default 6144
        depends on SINRICPRO_ENABLE_LOCAL_CONTROL
        help
            Stack for the UDP listener task. Device callbacks run on this task,
            on top of signature verification and JSON parsing, so lower it only
            after measuring the high-water mark of your own callbacks.

    config SINRICPRO_UDP_TASK_PRIORITY
        int "Local control task priority"
        default 5
        range 1 24
        depends on SINRICPRO_ENABLE_LOCAL_CONTROL
        help
            Priority of the UDP listener task.

endmenu
```

## examples/camera/main/Kconfig.projbuild
```kconfig
menu "SinricPro Camera Example"

    choice CAMERA_BOARD
        prompt "Camera board"
        default CAMERA_BOARD_AI_THINKER if IDF_TARGET_ESP32
        default CAMERA_BOARD_XIAO_S3_SENSE if IDF_TARGET_ESP32S3
        default CAMERA_BOARD_P4_MIPI_CSI if IDF_TARGET_ESP32P4
        help
            Selects the camera pin mapping. The processor alone does not
            identify the wiring, so choose the actual board.

        config CAMERA_BOARD_AI_THINKER
            bool "AI-Thinker ESP32-CAM"
            depends on IDF_TARGET_ESP32
        config CAMERA_BOARD_ESP_EYE
            bool "ESP-EYE"
            depends on IDF_TARGET_ESP32
        config CAMERA_BOARD_M5CAMERA
            bool "M5Camera model A"
            depends on IDF_TARGET_ESP32
        config CAMERA_BOARD_M5CAMERA_B
            bool "M5Camera model B"
            depends on IDF_TARGET_ESP32
        config CAMERA_BOARD_WROVER_KIT
            bool "ESP-WROVER-KIT"
            depends on IDF_TARGET_ESP32
        config CAMERA_BOARD_LILYGO_CAMERA
            bool "LILYGO TTGO T-Camera (camera only)"
            depends on IDF_TARGET_ESP32
        config CAMERA_BOARD_XIAO_S3_SENSE
            bool "XIAO ESP32S3 Sense"
            depends on IDF_TARGET_ESP32S3
        config CAMERA_BOARD_FREENOVE_S3
            bool "Freenove ESP32-S3 camera board"
            depends on IDF_TARGET_ESP32S3
        config CAMERA_BOARD_ESP32S3_WROOM
            bool "ESP32-S3 WROOM camera wiring (PWDN GPIO38)"
            depends on IDF_TARGET_ESP32S3
        config CAMERA_BOARD_ESP32S3_GOOUUU
            bool "GOOUUU ESP32-S3 camera wiring"
            depends on IDF_TARGET_ESP32S3
        config CAMERA_BOARD_P4_MIPI_CSI
            bool "ESP32-P4 board with a MIPI-CSI camera connector"
            depends on IDF_TARGET_ESP32P4
            help
                A 2-lane MIPI-CSI camera such as the OV5647 (Raspberry Pi
                Camera Rev 1.3). Only the sensor's I2C (SCCB) pins differ
                between boards; set them below.
    endchoice

    config CAMERA_SCCB_SDA_GPIO
        int "Camera SCCB (I2C) SDA GPIO"
        depends on CAMERA_BOARD_P4_MIPI_CSI
        range 0 54
        default 7
        help
            GPIO7/GPIO8 on the Espressif ESP32-P4-Function-EV-Board and the
            Waveshare ESP32-P4 boards, where the bus is shared with the
            audio codec.

    config CAMERA_SCCB_SCL_GPIO
        int "Camera SCCB (I2C) SCL GPIO"
        depends on CAMERA_BOARD_P4_MIPI_CSI
        range 0 54
        default 8

    config CAMERA_FLASH_GPIO
        int "Flash LED GPIO (-1 for none)"
        range -1 54
        default 4 if CAMERA_BOARD_AI_THINKER
        default -1
        help
            Exposes a flash toggle to viewers when set.

    config CAMERA_H264
        bool "Stream H.264 video on a WebRTC video track"
        depends on IDF_TARGET_ESP32S3 || IDF_TARGET_ESP32P4
        default y
        help
            Encodes H.264 (esp_h264) and sends it on a video track, which plays
            in a normal video element instead of being reassembled from
            DataChannel JPEG fragments. The S3 encodes in software, roughly
            320x240 at 10 fps; the P4 encodes in hardware, 800x640 at 15 fps or
            1280x960 at about 11 fps. Viewers that ask for no video track, and
            all other targets, keep the JPEG path.

    config CAMERA_MICROPHONE
        bool "Stream the onboard PDM microphone"
        depends on CAMERA_BOARD_XIAO_S3_SENSE
        default y
        help
            Sends an 8 kHz PCMU audio track alongside the video.

endmenu
```
